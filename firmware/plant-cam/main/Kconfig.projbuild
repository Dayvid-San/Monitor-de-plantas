## firmware/plant-cam/main/Kconfig.projbuild
```kconfig
menu "Plant Cam Configuration"

    config PLANT_CAM_WIFI_SSID
        string "Wi-Fi SSID"
        default "minha-rede"

    config PLANT_CAM_WIFI_PASSWORD
        string "Wi-Fi Password"
        default "minha-senha"

    config PLANT_CAM_ID
        string "ID desta câmera (camera_id)"
        default "esp32-cam-1"

    config PLANT_CAM_PLANT_ID
        int "ID da planta no dashboard associada a esta câmera (-1 = nenhuma)"
        default -1
        help
            Opcional. Se souber o id numérico da planta já cadastrada no
            dashboard, informe aqui para a foto aparecer vinculada a ela.
            Deixe -1 para enviar sem vínculo.

    config PLANT_CAM_BACKEND_HOST
        string "Host/IP do backend"
        default "192.168.1.100"

    config PLANT_CAM_BACKEND_PORT
        int "Porta do backend"
        default 3000

    config PLANT_CAM_API_KEY
        string "Chave de API (header X-API-Key)"
        default ""
        help
            Precisa ser igual à variável de ambiente DEVICE_API_KEY do backend.
            Deixe vazio se o backend não exige chave.

    config PLANT_CAM_CAPTURE_INTERVAL_SEC
        int "Intervalo entre fotos (segundos)"
        default 1800

endmenu
```

## firmware/plant-node/main/Kconfig.projbuild
```kconfig
menu "Plant Node Configuration"

    config PLANT_WIFI_SSID
        string "Wi-Fi SSID"
        default "minha-rede"

    config PLANT_WIFI_PASSWORD
        string "Wi-Fi Password"
        default "minha-senha"

    config PLANT_DEVICE_ID
        string "ID deste dispositivo (device_id)"
        default "esp32-node-1"
        help
            Precisa bater com o device_id cadastrado no dashboard para cada planta.

    config PLANT_BACKEND_HOST
        string "Host/IP do backend"
        default "192.168.1.100"

    config PLANT_BACKEND_PORT
        int "Porta do backend"
        default 3000

    config PLANT_READ_INTERVAL_SEC
        int "Intervalo entre leituras/envios (segundos)"
        default 60

    config PLANT_COMMAND_POLL_INTERVAL_SEC
        int "Intervalo de checagem de comandos pendentes (segundos)"
        default 8

endmenu
```
